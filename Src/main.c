
/**
  ******************************************************************************
  * @file           : main.c
  * @brief          : Main program body
  ******************************************************************************
  ** This notice applies to any and all portions of this file
  * that are not between comment pairs USER CODE BEGIN and
  * USER CODE END. Other portions of this file, whether 
  * inserted by the user or by software development tools
  * are owned by their respective copyright owners.
  *
  * COPYRIGHT(c) 2018 STMicroelectronics
  *
  * Redistribution and use in source and binary forms, with or without modification,
  * are permitted provided that the following conditions are met:
  *   1. Redistributions of source code must retain the above copyright notice,
  *      this list of conditions and the following disclaimer.
  *   2. Redistributions in binary form must reproduce the above copyright notice,
  *      this list of conditions and the following disclaimer in the documentation
  *      and/or other materials provided with the distribution.
  *   3. Neither the name of STMicroelectronics nor the names of its contributors
  *      may be used to endorse or promote products derived from this software
  *      without specific prior written permission.
  *
  * THIS SOFTWARE IS PROVIDED BY THE COPYRIGHT HOLDERS AND CONTRIBUTORS "AS IS"
  * AND ANY EXPRESS OR IMPLIED WARRANTIES, INCLUDING, BUT NOT LIMITED TO, THE
  * IMPLIED WARRANTIES OF MERCHANTABILITY AND FITNESS FOR A PARTICULAR PURPOSE ARE
  * DISCLAIMED. IN NO EVENT SHALL THE COPYRIGHT HOLDER OR CONTRIBUTORS BE LIABLE
  * FOR ANY DIRECT, INDIRECT, INCIDENTAL, SPECIAL, EXEMPLARY, OR CONSEQUENTIAL
  * DAMAGES (INCLUDING, BUT NOT LIMITED TO, PROCUREMENT OF SUBSTITUTE GOODS OR
  * SERVICES; LOSS OF USE, DATA, OR PROFITS; OR BUSINESS INTERRUPTION) HOWEVER
  * CAUSED AND ON ANY THEORY OF LIABILITY, WHETHER IN CONTRACT, STRICT LIABILITY,
  * OR TORT (INCLUDING NEGLIGENCE OR OTHERWISE) ARISING IN ANY WAY OUT OF THE USE
  * OF THIS SOFTWARE, EVEN IF ADVISED OF THE POSSIBILITY OF SUCH DAMAGE.
  *
  ******************************************************************************
  */
/* Includes ------------------------------------------------------------------*/
#include "main.h"
#include "stm32f1xx_hal.h"
#include "adc.h"
#include "tim.h"
#include "gpio.h"

/* USER CODE BEGIN Includes */
#include <math.h>

#define PI      				 3.1415926535897
#define N_point     		 512
#define N_freq       		 N_point/2 // frequency N_freq = 0 is DC signal  
#define FP_PRECISION 		 8  
#define FP_MASK 			 	 ((1<<FP_PRECISION) - 1)
#define FP__MUL(A, B)    ((int16_t)(((int32_t)(A) * (int32_t)(B)) >> FP_PRECISION))

#define log2N 9


#define OE_DIS     HAL_GPIO_WritePin(OE_GPIO_Port,  OE_Pin,  GPIO_PIN_SET)
#define OE_EN      HAL_GPIO_WritePin(OE_GPIO_Port,  OE_Pin,  GPIO_PIN_RESET)
#define A_SET      HAL_GPIO_WritePin(A_GPIO_Port,   A_Pin,   GPIO_PIN_SET)
#define A_RESET    HAL_GPIO_WritePin(A_GPIO_Port,   A_Pin,   GPIO_PIN_RESET)
#define B_SET      HAL_GPIO_WritePin(B_GPIO_Port,   B_Pin,   GPIO_PIN_SET)
#define B_RESET    HAL_GPIO_WritePin(B_GPIO_Port,   B_Pin,   GPIO_PIN_RESET)
#define CLK_SET    HAL_GPIO_WritePin(CLK_GPIO_Port, CLK_Pin, GPIO_PIN_SET)
#define CLK_RESET  HAL_GPIO_WritePin(CLK_GPIO_Port, CLK_Pin, GPIO_PIN_RESET)
#define LAT_SET    HAL_GPIO_WritePin(LAT_GPIO_Port, LAT_Pin, GPIO_PIN_SET)
#define LAT_RESET  HAL_GPIO_WritePin(LAT_GPIO_Port, LAT_Pin, GPIO_PIN_RESET) 
#define R1_SET     HAL_GPIO_WritePin(R1_GPIO_Port,  R1_Pin,  GPIO_PIN_SET)
#define R1_RESET   HAL_GPIO_WritePin(R1_GPIO_Port,  R1_Pin,  GPIO_PIN_RESET)
#define G1_SET     HAL_GPIO_WritePin(G1_GPIO_Port,  G1_Pin,  GPIO_PIN_SET)
#define G1_RESET   HAL_GPIO_WritePin(G1_GPIO_Port,  G1_Pin,  GPIO_PIN_RESET)

#define chonHang(h)  (0x02&h)?B_SET:B_RESET; \
                     (0x01&h)?A_SET:A_RESET; \
                      OE_EN
	
/* USER CODE END Includes */

/* Private variables ---------------------------------------------------------*/

/* USER CODE BEGIN PV */
/* Private variables ---------------------------------------------------------*/
uint8_t  LED1[16][32];
uint8_t  LED2[16][32];
int16_t xn[N_point]; 
//int16_t buffer[N_point];
uint8_t  sampleDone;
/* USER CODE END PV */

/* Private function prototypes -----------------------------------------------*/
void SystemClock_Config(void);

/* USER CODE BEGIN PFP */
/* Private function prototypes -----------------------------------------------*/

/* USER CODE END PFP */

/* USER CODE BEGIN 0 */

const uint16_t bitRevTable512[512] = 
{
    0x0000, 0x0100, 0x0080, 0x0180, 0x0040, 0x0140, 0x00C0, 0x01C0,
    0x0020, 0x0120, 0x00A0, 0x01A0, 0x0060, 0x0160, 0x00E0, 0x01E0,
    0x0010, 0x0110, 0x0090, 0x0190, 0x0050, 0x0150, 0x00D0, 0x01D0,
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    0x003F, 0x013F, 0x00BF, 0x01BF, 0x007F, 0x017F, 0x00FF, 0x01FF
};

const int16_t cosTable[512] = 
{
		0xff,		0xff,		0xff,		0xff,		0xff,		0xff,		0xff,		0xff,	
		0xfe,		0xfe,		0xfe,		0xfd,		0xfd,		0xfc,		0xfc,		0xfb,	
		0xfb,		0xfa,		0xf9,		0xf9,		0xf8,		0xf7,		0xf6,		0xf5,	
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		0xfe,		0xff,		0xff,		0xff,		0xff,		0xff,		0xff,		0xff
};

const int16_t sinTable[512] = 
{
		0x0,		0xfffd,	0xfffa,	0xfff7,	0xfff4,	0xfff1,	0xffee,	0xffeb,	
		0xffe7,	0xffe4,	0xffe1,	0xffde,	0xffdb,	0xffd8,	0xffd5,	0xffd2,	
		0xffcf,	0xffcb,	0xffc8,	0xffc5,	0xffc2,	0xffbf,	0xffbc,	0xffb9,	
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		0x19,		0x15,		0x12,		0xf,		0xc,		0x9,		0x6,		0x3
};	
/* define for FFT caculate */
										
void P10_scan(void) 	
{
	static uint8_t hang = 0;
	static uint8_t	count = 0;
	/* quet led */
	uint8_t x, y, z, temp1, temp2;
	OE_DIS;
	for(z = 0; z <= 16; z += 16)
	{
		for(y = 0; y <= 12; y += 4)
		{
			temp1 = hang+12-y;
			for(x = 0; x < 16; x++)
			{	
				temp2 = x + z;
				LED1[temp1][temp2] > count ? R1_SET : R1_RESET; /* pin Red data   */
				LED2[temp1][temp2] > count ? G1_SET : G1_RESET; /* pin Green data */
				CLK_SET;
				CLK_RESET;
			}
		}
	}
	LAT_SET;
	LAT_RESET;
	chonHang(hang);
	if(++hang == 4) 
	{
			hang = 0;
			if(++count == 15) count = 0;
	}
}

void P10_draw(int16_t *mag)
{
	uint16_t i, x;
	for(i = 1; i <= 32; i++)
	{
		if(mag[i] >= 16)
		{
			for(x = 16; x > 1; x--)
			{
				LED1[16 - x][i-1] = 15;
				LED2[16 - x][i-1] = 0;
			}
		}
		
		if(mag[i] < 16)
		{
			for(x = mag[i]; x > 1; x--) 
			{			
				LED1[16 - x][i-1] = 15;
				LED2[16 - x][i-1] = 0;
			}
			for(x = 16; x > mag[i]; x--) LED1[16 - x][i-1] = LED2[16 - x][i-1] = 0;
		}
		
		if(mag[i] == 0) { LED1[15][i-1] = 0; LED2[15][i-1] = 15; } 
	}
}

uint16_t ADC_read(void)
{
	HAL_ADC_Start(&hadc1);
	while(!__HAL_ADC_GET_FLAG(&hadc1, ADC_FLAG_EOC));
	HAL_ADC_Stop(&hadc1);
	return (uint16_t)HAL_ADC_GetValue(&hadc1);
}

void FFT_calculate(int16_t *R)
{
	int16_t I[N_point];
	uint16_t step, temp3, temp, tem, k, j;
	for(k = 0; k < N_point; k++) I[k] = 0;
	for(step = 1; step <= log2N; step++)
	{
		temp3 = 1<<(step -1);  
		for(k = 0; k < temp3; k++)
		{
			temp = 1<<(step);;
			tem = k*N_point/temp;
			int16_t WR = cosTable[tem];
			int16_t WI = sinTable[tem];			
			for(j = 0; j < N_point; j+=temp)
			{						
				int16_t tempR, tempI;
				tempR = FP__MUL(WR, R[j + temp3 + k]) - FP__MUL(WI, I[j + temp3 + k]);
				tempI = FP__MUL(WR, I[j + temp3 + k]) + FP__MUL(WI, R[j + temp3 + k]);
				
				
				R[j + temp3 + k]   = (R[j + k] - tempR);//WR * R[j + temp3 + k] + WI * I[j + temp3 + k];
				I[j + temp3 + k]   = (I[j + k] - tempI);//WR * I[j + temp3 + k] - WI * temp2;	
				
				R[j + k]           = (R[j + k] + tempR);//WR * R[j + temp3 + k] - WI * I[j + temp3 + k];						
				I[j + k]      	   = (I[j + k] + tempI);//WR * I[j + temp3 + k] + WI * temp2;			
			}
		}
	}
	
	for(k = 1; k <= 32; k++)
	{
		R[k] = (int16_t)sqrt(R[k]*R[k] + I[k]*I[k]);
		R[k] >>= 6;
	}
}

//void FFT_calculate(int16_t *R, int16_t *I, uint16_t N)
//{
//	if(N >= 2)
//	{
//		N /= 2;
//		FFT_calculate(R,     I,     N);
//		FFT_calculate(R + N, I + N, N);

//		for(uint16_t k = 0; k < N; k++)
//		{
//			uint16_t tem = k*256/N;
//			int16_t WR = cosTable[tem];
//			int16_t WI = sinTable[tem];

//			/************************/
//			/*  Ek_re = R[k]        */
//			/*  Ek_im = R[k + N]  */
//			/*  Ok_re = I[k]        */
//			/*  Ok_im = I[k + N]  */
//			/************************/
//			int16_t tempR, tempI;
//			tempR = FP__MUL(WR, R[k + N]) - FP__MUL(WI, I[k + N]);
//			tempI = FP__MUL(WR, I[k + N]) + FP__MUL(WI, R[k + N]);
//			
//			R[k + N] = (R[k] - tempR);
//			I[k + N] = (I[k] - tempI);
//			
//			R[k]     = (R[k] + tempR);
//			I[k]     = (I[k] + tempI);
//			
////			//Tranh overflow			
////			R[k + N] = (R[k] - tempR)>>1;
////			I[k + N] = (I[k] - tempI)>>1;
////			
////			R[k]     = (R[k] + tempR)>>1;
////			I[k]     = (I[k] + tempI)>>1;		
//		}
//	}
//}


//void mag(int16_t *R, int16_t *I)
//{
//	uint16_t k;
//	for(k = 1; k <= 32; k++)
//	{
//		R[k] = (int16_t)sqrt(R[k]*R[k] + I[k]*I[k]);
//		R[k] >>= 6;
//	}
//}

void HAL_TIM_PeriodElapsedCallback(TIM_HandleTypeDef *htim)
{
	if(htim->Instance == htim2.Instance)
	{
		P10_scan();
	}
	
	else
	if(htim->Instance == htim3.Instance)  // sample 512 points at 38kHz
	{
		uint16_t adc_value;
		static uint16_t cnt = 0;
		adc_value = ADC_read()>>2;  // >>2 10bit value
	  if(sampleDone == 0)
	  {
		  xn[bitRevTable512[cnt]] = adc_value;
			//buffer[cnt] = 0;
		  cnt++;
		  if(cnt > N_point)
		  {
			  sampleDone = 1;
			  cnt = 0;
		  }
	  }
	}
}
/* USER CODE END 0 */

/**
  * @brief  The application entry point.
  *
  * @retval None
  */
int main(void)
{
  /* USER CODE BEGIN 1 */

  /* USER CODE END 1 */

  /* MCU Configuration----------------------------------------------------------*/

  /* Reset of all peripherals, Initializes the Flash interface and the Systick. */
  HAL_Init();

  /* USER CODE BEGIN Init */

  /* USER CODE END Init */

  /* Configure the system clock */
  SystemClock_Config();

  /* USER CODE BEGIN SysInit */

  /* USER CODE END SysInit */

  /* Initialize all configured peripherals */
  MX_GPIO_Init();
  MX_TIM2_Init();
  MX_TIM3_Init();
  MX_ADC1_Init();
  /* USER CODE BEGIN 2 */
	for(uint8_t i = 0; i < 32; i++)
	{ LED1[15][i] = 0; LED2[15][i] = 15; } 
	HAL_TIM_Base_Start_IT(&htim2);
	HAL_TIM_Base_Start_IT(&htim3);
  /* USER CODE END 2 */

  /* Infinite loop */
  /* USER CODE BEGIN WHILE */
  while (1)
  {

  /* USER CODE END WHILE */

  /* USER CODE BEGIN 3 */
		while(!sampleDone);
		HAL_TIM_Base_Stop_IT(&htim3);
		FFT_calculate(xn);
//		FFT_calculate(xn, buffer, N_point);
//		mag(xn, buffer);
		P10_draw(xn);
		//P10_effect1(g_xn);
		sampleDone = 0;
		HAL_TIM_Base_Start_IT(&htim3);
  }
  /* USER CODE END 3 */

}

/**
  * @brief System Clock Configuration
  * @retval None
  */
void SystemClock_Config(void)
{

  RCC_OscInitTypeDef RCC_OscInitStruct;
  RCC_ClkInitTypeDef RCC_ClkInitStruct;
  RCC_PeriphCLKInitTypeDef PeriphClkInit;

    /**Initializes the CPU, AHB and APB busses clocks 
    */
  RCC_OscInitStruct.OscillatorType = RCC_OSCILLATORTYPE_HSE;
  RCC_OscInitStruct.HSEState = RCC_HSE_ON;
  RCC_OscInitStruct.HSEPredivValue = RCC_HSE_PREDIV_DIV1;
  RCC_OscInitStruct.HSIState = RCC_HSI_ON;
  RCC_OscInitStruct.PLL.PLLState = RCC_PLL_ON;
  RCC_OscInitStruct.PLL.PLLSource = RCC_PLLSOURCE_HSE;
  RCC_OscInitStruct.PLL.PLLMUL = RCC_PLL_MUL9;
  if (HAL_RCC_OscConfig(&RCC_OscInitStruct) != HAL_OK)
  {
    _Error_Handler(__FILE__, __LINE__);
  }

    /**Initializes the CPU, AHB and APB busses clocks 
    */
  RCC_ClkInitStruct.ClockType = RCC_CLOCKTYPE_HCLK|RCC_CLOCKTYPE_SYSCLK
                              |RCC_CLOCKTYPE_PCLK1|RCC_CLOCKTYPE_PCLK2;
  RCC_ClkInitStruct.SYSCLKSource = RCC_SYSCLKSOURCE_PLLCLK;
  RCC_ClkInitStruct.AHBCLKDivider = RCC_SYSCLK_DIV1;
  RCC_ClkInitStruct.APB1CLKDivider = RCC_HCLK_DIV2;
  RCC_ClkInitStruct.APB2CLKDivider = RCC_HCLK_DIV1;

  if (HAL_RCC_ClockConfig(&RCC_ClkInitStruct, FLASH_LATENCY_2) != HAL_OK)
  {
    _Error_Handler(__FILE__, __LINE__);
  }

  PeriphClkInit.PeriphClockSelection = RCC_PERIPHCLK_ADC;
  PeriphClkInit.AdcClockSelection = RCC_ADCPCLK2_DIV6;
  if (HAL_RCCEx_PeriphCLKConfig(&PeriphClkInit) != HAL_OK)
  {
    _Error_Handler(__FILE__, __LINE__);
  }

    /**Configure the Systick interrupt time 
    */
  HAL_SYSTICK_Config(HAL_RCC_GetHCLKFreq()/1000);

    /**Configure the Systick 
    */
  HAL_SYSTICK_CLKSourceConfig(SYSTICK_CLKSOURCE_HCLK);

  /* SysTick_IRQn interrupt configuration */
  HAL_NVIC_SetPriority(SysTick_IRQn, 0, 0);
}

/* USER CODE BEGIN 4 */

/* USER CODE END 4 */

/**
  * @brief  This function is executed in case of error occurrence.
  * @param  file: The file name as string.
  * @param  line: The line in file as a number.
  * @retval None
  */
void _Error_Handler(char *file, int line)
{
  /* USER CODE BEGIN Error_Handler_Debug */
  /* User can add his own implementation to report the HAL error return state */
  while(1)
  {
  }
  /* USER CODE END Error_Handler_Debug */
}

#ifdef  USE_FULL_ASSERT
/**
  * @brief  Reports the name of the source file and the source line number
  *         where the assert_param error has occurred.
  * @param  file: pointer to the source file name
  * @param  line: assert_param error line source number
  * @retval None
  */
void assert_failed(uint8_t* file, uint32_t line)
{ 
  /* USER CODE BEGIN 6 */
  /* User can add his own implementation to report the file name and line number,
     tex: printf("Wrong parameters value: file %s on line %d\r\n", file, line) */
  /* USER CODE END 6 */
}
#endif /* USE_FULL_ASSERT */

/**
  * @}
  */

/**
  * @}
  */

/************************ (C) COPYRIGHT STMicroelectronics *****END OF FILE****/
